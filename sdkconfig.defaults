## sdkconfig.defaults
```kconfig
#
# Modbus Configuration
#
CONFIG_MB_UART_PORT_ONE=y
CONFIG_MB_UART_PORT_NUM=1
CONFIG_MB_UART_BAUD_RATE=9600
CONFIG_MB_UART_RXD=25
CONFIG_MB_UART_TXD=26
CONFIG_MB_UART_RTS=33
CONFIG_MB_COMM_MODE_RTU=y
# CONFIG_MB_COMM_MODE_ASCII is not set
CONFIG_MB_SLAVE_ADDR=1
# end of Modbus Configuration

#
# SPnet Configuration
#
CONFIG_SP_UART_PORT_TWO=y
CONFIG_SP_UART_PORT_NUM=2
CONFIG_SP_UART_BAUD_RATE=9600
CONFIG_SP_UART_RXD=21
CONFIG_SP_UART_TXD=23
CONFIG_SP_UART_RTS=22
CONFIG_SP_TASK_STACK_SIZE=3072
# end of SPnet Configuration
```
